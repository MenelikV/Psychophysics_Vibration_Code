#include <Wire.h>
#include <DueTimer.h> // Arduino Due timer


// I2C communication information
int f1;  // frequency of the first stimulus 
float amp1;   // amplitude of the first stimulus
int f2;  // frequency of the second stimulus
float amp2;   // amplitude of the second stimulus
int wave;   // waveform
int x;

int f_new;
int num_samples = 1000;
int i = 0;
int j = 0;
int k = 0;
int duration, pause_t;
char data[50];
int indices[6];
String test;
String f_new_s, amp1_s, amp2_s, duration_s, pause_t_s;


bool received_data = false;


// table of data send by Matlab through the first arduino
const uint16_t sinTable[] = {0x800,0x80C,0x819,0x826,0x833,0x840,0x84D,0x85A,0x866,0x873,0x880,0x88D,0x89A,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0x7FF,
};

void sine1()
{
  analogWrite(DAC0, sinTable[i]*amp1);
  i = (i+f_new)%num_samples;
}

void sine2()
{
  analogWrite(DAC0, sinTable[i]*amp2);
  i = (i+f_new)%num_samples;
}

void setup()
{
  analogWriteResolution(12);
  analogReadResolution(12);
  Wire.begin(1);                // join i2c bus with address #1
  Wire.onReceive(receiveEvent); // register event
  Serial.begin(57600);          // start serial for output
  Timer1.attachInterrupt(sine1).setFrequency(num_samples);  // max frequency is around 140.000 samples per second
  Timer2.attachInterrupt(sine2).setFrequency(num_samples);

}

void loop()
{
  delay(100);
  if(received_data)
  {
   Serial.println("So weit, so gut");
   for(i=0;i<50;i++)
   {
    test += data[i];
   }
   Serial.println(test);
   f_new_s = test.substring(indices[0]+3,indices[1]+1);
   f_new = f_new_s.toInt();
   Serial.println(f_new_s);
   amp1_s = test.substring(indices[2]+3,indices[3]+1);
   amp1 = amp1_s.toFloat();
   amp2_s = test.substring(indices[3]+3, indices[4]+1);
   amp2 = amp2_s.toFloat();
   duration_s = test.substring(indices[4]+3,indices[5]+1);
   duration = duration_s.toInt();
   pause_t_s = test.substring(indices[5]+3,indices[6]+1);
   pause_t =  pause_t_s.toInt();

//amp1 = 0.8;
//amp2 = 0.7;
//duration = 500000;
//pause_t = 500000;
//f_new = 10;
  
   Serial.println(amp1);
   Serial.println(amp2);
   Serial.println(duration);
   Serial.println(pause_t);
   //Serial.println(f_new);
  
   Timer1.start();
   delay(duration);
   Timer1.stop();
   delay(pause_t);
  
  // New set for second stimuli
   f_new_s = test.substring(indices[1]+3,indices[2]+1);
   f_new = f_new_s.toInt();
   Serial.println(f_new);
  
   Timer2.start();
   delay(duration);
   Timer2.stop();
   received_data =  false;
   i = 0;
   j = 0;
   k = 0;
   memset(data, 0, sizeof(data));
   test = "";
  }
}

// function that executes whenever data is received from master
// this function is registered as an event, see setup()
void receiveEvent(int howMany)
{
  while(Wire.available() > 0)
  {
  j++;
  data[j] = Wire.read();    // receive byte as a char
  if(data[j] == 240)
  {
    data[j] = 0;
  }
  if(data[j] == 'n')
  {
    indices[k] = j-2;
    k++;
    if(k == 7)
    {
      received_data = true;
    }
   }
  }
}


